## CMakeLists.txt
```
cmake_minimum_required(VERSION 3.20.0)

# Find the Zephyr SDK workspace
find_package(Zephyr REQUIRED HINTS $ENV{ZEPHYR_BASE})

# Set the project name
project(blinky)

# Header files
target_include_directories(app PRIVATE include/)

# Source files
target_sources(app PRIVATE src/trinket.c)
target_sources(app PRIVATE src/main.c)
```

## prj.conf
```kconfig
CONFIG_GPIO=y

CONFIG_SERIAL=y

CONFIG_LED_STRIP=y
CONFIG_APA102_STRIP=y
CONFIG_SPI=y
CONFIG_POLL=y
```

## src/main.c
```c
#include <zephyr/zephyr.h>
// #include <zephyr/device.h>
// #include <zephyr/drivers/gpio.h>
// #include <zephyr/drivers/led_strip.h>
// #include <zephyr/drivers/spi.h>
// #include <zephyr/sys/util.h>

#include "trinket.h"

// Semaphore colors

void red()    { dotstar_led_set_rgb(255, 0,   0); }
void green()  { dotstar_led_set_rgb(0,   255, 0); }
void yellow() { dotstar_led_set_rgb(255, 255, 0); }

// Entry point

void main() {

	user_led_init();
	dotstar_led_init();

	while (1) {

		print_string("Go!");
		green();
		sleep(3000);

		print_string("Caution!");
		yellow();
		sleep(2000);

		print_string("Stop!");
		red();
		sleep(3000);

		print_string("Caution!");
		yellow();
		sleep(1000);

	}
}
```

## include/trinket.h
```c
// ---------------------------------------- //
// Adafruit Trinket M0 driver               //
// ---------------------------------------- //

// User LED

void user_led_init();
void user_led_toggle();
void user_led_on();
void user_led_off();

// DotStar RGB LED

void dotstar_led_init();
void dotstar_led_set_rgb(int r, int g, int b);

// Sleep

void sleep(int millis);

// Printing

void print_string(char* str);
```

## src/trinket.c
```c
#include <zephyr/zephyr.h>
#include <zephyr/drivers/led_strip.h>
#include <zephyr/drivers/spi.h>

#include "trinket.h"

// ---------------------------------------- //
// Adafruit Trinket M0 driver               //
// ---------------------------------------- //

// User LED

static const struct gpio_dt_spec user_led = GPIO_DT_SPEC_GET(DT_ALIAS(led0), gpios);

void user_led_init() {
	gpio_pin_configure_dt(&user_led, GPIO_OUTPUT_ACTIVE);
}

void user_led_toggle() {
	gpio_pin_toggle_dt(&user_led);
}

void user_led_on() {
	gpio_pin_set_dt(&user_led, 1);
}

void user_led_off() {
	gpio_pin_set_dt(&user_led, 0);
}

// DotStar RGB LED

const struct device* dotstar_led;

void dotstar_led_init() {
	dotstar_led = DEVICE_DT_GET_ANY(apa_apa102);
	struct led_rgb black = { .r = 0, .g = 0, .b = 0 };
	led_strip_update_rgb(dotstar_led, &black, 1);
}

void dotstar_led_set_rgb(int r, int g, int b) {
	struct led_rgb color = { .r = (char) r, .g = (char) g, .b = (char) b };
	led_strip_update_rgb(dotstar_led, &color, 1);
}

// Sleep

void sleep(int millis) {
	k_msleep(millis);
}

// Printing

void print_string(char* str) {
	printk("%s\n", str);
}
```
